## sources/meta-local/conf/distro/xilinx-standalone-kp.conf
```bitbake
require conf/distro/xilinx-standalone.inc

DISTROOVERRIDES_prepend = "${@'xilinx-standalone:' if d.getVar('DISTRO') != "xilinx-standalone-kp" else ''}"

DISTRO_NAME_append = " (lto)"

NANO_OPTIONS = "-fno-exceptions -fdata-sections -ffunction-sections"

# By default we want to optimize for size.
FULL_OPTIMIZATION = "-Os -pipe ${DEBUG_FLAGS} ${NANO_OPTIONS}"

# Workaround for microblaze -Os bug
FULL_OPTIMIZATION_microblaze = "-O2 -pipe ${DEBUG_FLAGS} ${NANO_OPTIONS}"

DEBUG_OPTIMIZATION = "-Og ${DEBUG_FLAGS} -pipe ${NANO_OPTIONS}"
DEBUG_OPTIMIZATION_microblaze = "-Og ${DEBUG_FLAGS} -pipe ${NANO_OPTIONS}"

# We also need to use Link Time Optimization for many items, make this the
# default.
ESW_CFLAGS += " -flto -ffat-lto-objects"
```

## sources/meta-local/conf/machine/microblaze-tc-kp.conf
```bitbake
require conf/machine/microblaze-tc.conf

MULTILIBS = ""
MULTILIBS += "multilib:libmblebsp"
```
